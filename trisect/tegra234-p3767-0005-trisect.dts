/*
 * Top level DTS file for CVM:P3767-0000 and CVB:antmicro-job.
 *
 * Copyright (c) 2021-2022, NVIDIA CORPORATION.  All rights reserved.
 * Copyright (c) 2026 Antmicro <www.antmicro.com>
 *
 * This program is free software; you can redistribute it and/or modify
 * it under the terms of the GNU General Public License as published by
 * the Free Software Foundation; version 2 of the License.
 *
 * This program is distributed in the hope that it will be useful, but WITHOUT
 * ANY WARRANTY; without even the implied warranty of MERCHANTABILITY or
 * FITNESS FOR A PARTICULAR PURPOSE.  See the GNU General Public License for
 * more details.
 */

/dts-v1/;
#include "nv-platform/tegra234-p3768-0000+p3767-0005-nv-super.dts"
#include "antmicro/tegra234-antmicro-job.dtsi"

/* AVT cameras */
#include "tegra234-alvium-camera-dual-j7.dtsi"

/* Does not currently work */
/*#include "tegra234-imx477-j8.dtsi"*/

/ {
	nvidia,dtsfilename = __FILE__;
	nvidia,dtbbuildtime = __DATE__, __TIME__;
	compatible = "nvidia,p3768-0000+p3767-0005-super", "nvidia,p3767-0005", "nvidia,tegra234";
	model = "NVIDIA Orin Nano 8GB SoM on Antmicro Jetson Orin Baseboard (Super) with Dual AVT cameras";
};
