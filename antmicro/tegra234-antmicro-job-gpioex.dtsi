/*
 * Copyright (c) 2023 Antmicro <www.antmicro.com>
 *
 * This program is free software; you can redistribute it and/or modify
 * it under the terms of the GNU General Public License as published by
 * the Free Software Foundation; version 2 of the License.
 *
 * This program is distributed in the hope that it will be useful, but WITHOUT
 * ANY WARRANTY; without even the implied warranty of MERCHANTABILITY or
 * FITNESS FOR A PARTICULAR PURPOSE.  See the GNU General Public License for
 * more details.
 */


&gen2_i2c {
	job_gpio_expander: gpio@20 {
	/* @trisect
		The chip is really a "nxp,pcal6408"
		However support for that chip is included in the gpio-pca953x
		driver in Linux 6.1, and the driver is build by default into the
		L4T kernel (not as a module).   Antmicro provide a patched kernel,
		As a short cut, rather than build a custom kernel we mislabel
		the chip here.  According to the pca653x compatibility list:

		https://docs.kernel.org/driver-api/gpio/pca953x.html

		and the pca953x code, the pcal9554b and 6408 are treated identically.
		*/
		compatible = "nxp,pcal9554b";
		status = "okay";
		reg = <0x20>;
		gpio-controller;
		#gpio-cells = <2>;
		gpio-line-names =
			"CSIA_PEN",
			"CSIB_PEN",
			"USBC1_PEN",
			"DISABLE_POE_DCDC",
			"CSIA_FLG",
			"CSIB_FLG",
			"USBC1_FLG",
			"USBC0_FLG";
		interrupt-parent = <&gpio>;
		interrupts = <TEGRA234_MAIN_GPIO(P, 6) GPIO_ACTIVE_LOW>;
		interrupt-controller;
		#interrupt-cells = <2>;

		disable_poe_dcdc-hog {
			gpio-hog;
			gpios = <3 GPIO_ACTIVE_HIGH>;
			output-low;
		};
	};
};
